	.INCLUDE "M32DEF.INC"
	.ORG 0
	RJMP main
	.ORG $200
.DB $EE,$ED,$EB,$E7,$DE,$DD,$DB,$D7,$BE,$BD,$BB,$B7,$7E,$7D,$7B,$77
	.ORG $300
main: CLR R16
	  OUT DDRA,R16
	  OUT SFIOR,R16
	  SER R16
	  OUT PORTA,R16
	  OUT DDRB,R16
	  OUT DDRC,R16
	  IN R16,PINA
	  CLR R17
	  CLR R18
l1:	  CPI R16,10
	  BRLO l2
	  SUBI R16,10
	  INC R17
	  RJMP l1
l2:	  CPI R17,10
	  BRLO exit
	  SUBI R17,10
	  INC R18
	  RJMP l2
exit: LDI R31,$02
	  MOV R30,R16
	  LPM R19,Z
	  MOV R30,R17
	  LPM R20,Z
	  MOV R30,R18
	  LPM R21,Z
l3:	  SBI PORTC,0
	  SBI PORTC,1
	  SBI PORTC,2
	  OUT PORTB,R19
	  CBI PORTC,0
	  SBI PORTC,0
	  OUT PORTB,R20
	  CBI PORTC,1
	  SBI PORTC,1
	  OUT PORTB,R21
	  CBI PORTC,2
	  RJMP l3

