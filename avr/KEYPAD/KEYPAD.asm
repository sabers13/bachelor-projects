.INCLUDE "M32DEF.INC"
	.ORG 0
	RJMP main
	.ORG $100
.DB $3F,$06,$DB,$CF,$E6,$ED,$FD,$07,$FF,$EF,$EE,$ED,$EB,$E7,$DE,$DD,$DB,$D7,$BE,$BD,$BB,$B7,$7E,$7D,$7B,$77
	.ORG $200
main:	LDI R16,$0F
	 	OUT DDRA,R16
	 	CLR R16
	 	OUT SFIOR,R16
	 	SER R16
	 	OUT PORTA,R16
		OUT PORTB,R16
	 	CLR R18
wait1:	IN R16,PINA
	 	ANDI R16,$F0
	 	CPI R16,$F0
	 	BRNE wait1
loop1:	LDI R17,$0E
wait2:	OUT PORTA,R17
		IN R16,PINA
	 	ANDI R16,$F0
	 	CPI R16,$F0
	 	BRNE search
		INC R18
		SEC
		ROL R17
		CPI R18,4
		BRNE wait2
		CLR R18
		RJMP loop1
search:	ANDI R17,$0F
		OR R16,R17
		CLR R18
		CLR R30
		ADIW R30,10
		LDI R31,$02
loop2:	LPM R17,Z
		CP R17,R16
		BREQ end1
		INC R18
		INC R30
		CPI R18,16
		BRNE loop2
		RJMP wait1
END1: CLR R16
	  OUT DDRA,R16
	  OUT SFIOR,R16
	  SER R16
	  OUT DDRB,R16
	  OUT DDRC,R16
	  CLR R17
	  LDI R16,35
l1:	  CPI R16,10
	  BRLO exit
	  SUBI R16,10
	  INC R17
	  RJMP l1
exit: LDI R31,$02
	  MOV R30,R16
	  LPM R19,Z
	  MOV R30,R17
	  LPM R20,Z

l3:	  SBI PORTC,0
	  SBI PORTC,1
	  OUT PORTB,R19
	  CBI PORTC,0
	  SBI PORTC,0
	  OUT PORTB,R20
	  CBI PORTC,1
	  SBI PORTC,1
	  OUT PORTB,R21
	  RJMP l3
